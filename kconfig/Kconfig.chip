## kconfig/Kconfig.chip
```kconfig
choice  
        prompt "Target SoC"
        default BERLIN_PLATYPUS_A0

config BERLIN_AS470_A0
        bool "BERLIN AS470 A0"

config BERLIN_DOLPHIN_Z1
        bool "BERLIN DOLPHIN Z1"

config BERLIN_PLATYPUS_A0
        bool "BERLIN PLATYPUS A0"

config BERLIN_DOLPHIN_A0
        bool "BERLIN DOLPHIN A0"

config BERLIN_MYNA2_A0
        bool "BERLIN MYNA2 A0"

config BERLIN_KLAMATH
        bool "BERLIN KLAMATH"

config DVF101
        bool "DVF101"

config DVF99
        bool "DVF99"

config DVF9918
        bool "DVF9918"

config DVF9928
        bool "DVF9928"

config DVF97
        bool "DVF97"
endchoice
```

## module/ampsdk/kconfig/Kconfig.drm.widevine.provision
```kconfig
config AMP_IP_DRM_WV_PROVISION_20
    bool "Provision 2.0"

config AMP_IP_DRM_WV_PROVISION_40
    bool "Provision 4.0"
```

## module/ampsdk/kconfig/Kconfig.video
```kconfig
menu "Video Pipeline"

config AMP_COMPONENT_VENC_ENABLE
    bool "VENC (Video Encoder) Enable"
    default y

#config AMP_COMPONENT_IMGDEC_ENABLE
#    bool "Imgdec Enable"
#    default n

config AMP_COMPONENT_VOUT_ENABLE
    bool "VOUT (Video Output) Enable"
    default y

config AMP_COMPONENT_DEINT_ENABLE
    bool "DEINT (Offline Video Deinterlace) Enable"
    default y

config AMP_COMPONENT_SCALER_ENABLE
    bool "SCALER (Offline Video Scaler) Enable"
    default y

config AMP_COMPONENT_SR_ENABLE
    bool "SuperRes (AI Video Scaling) Enable"
    default n
    depends on SYNAP

config AMP_COMPONENT_VA_ENABLE
    bool "Video Analytics Enable"
    default n
    depends on SYNAP

source "module/ampsdk/kconfig/Kconfig.video.vdec"
source "module/ampsdk/kconfig/Kconfig.video.dispsrv"

menu "HDR SETTINGS"

config AMP_HLG
    bool "HLG (Hybrid Log-Gamma) HDR"
    default y

config AMP_THDR
    bool "Technicolor HDR"
    default y

config AMP_HDR10_PLUS
    bool "HDR10 Plus"
    default n

config AMP_DOLBY_VISION
    bool "Dolby Vision HDR"
    imply AMP_DOLBY_VISION_V2_4
    default y
    select AMP_COMPONENT_DVS_ENABLE

if AMP_DOLBY_VISION
config AMP_DOLBY_VISION_V2_4
    bool "dolby vision v2.4"
    default n

config AMP_DOLBY_VISION_V2_6
    bool "dolby vision v2.6"
    default n
endif

config AMP_COMPONENT_DVS_ENABLE
    depends on AMP_DOLBY_VISION
    bool
    default y

config AMP_DOLBY_DUMP
    bool
    prompt "Overlay Frame Dump" if AMP_DEVELOPMENT_OPTION
    default n

endmenu

endmenu
```

## module/ampsdk/kconfig/select_build/Kconfig.drm.widevine.select
```kconfig
choice
    prompt "Select"
    default AMP_IP_DRM_WV_16
source "module/ampsdk/kconfig/Kconfig.drm.widevine.version"
endchoice
choice
    prompt "Select"
    default AMP_IP_DRM_WV_PROVISION_20
source "module/ampsdk/kconfig/Kconfig.drm.widevine.provision"
endchoice
```

## module/tee_dev/Kconfig.common
```kconfig
config TEE_DEV
	bool
	default y

config TEE_DEV_REL_PATH
	string
	default "tee_dev"
	help
		Used as ${CONFIG_SYNA_SDK_OUT_TARGET_PATH}/${CONFIG_TEE_DEV_REL_PATH}
		There will be lib and include folder under it.

config TEE_OPENSSL_VERSION
        string "OPENSSL version"
        default "1_0_2p"
```
